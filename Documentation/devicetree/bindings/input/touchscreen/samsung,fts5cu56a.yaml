## Documentation/devicetree/bindings/input/touchscreen/samsung,fts5cu56a.yaml
```yaml
# SPDX-License-Identifier: (GPL-2.0-only OR BSD-2-Clause)
%YAML 1.2
---
$id: http://devicetree.org/schemas/input/touchscreen/samsung,fts5cu56a.yaml#
$schema: http://devicetree.org/meta-schemas/core.yaml#

title: Samsung FTS5CU56A touchscreen controller

maintainers:
  - Ben Graham <64079735+ben443@users.noreply.github.com>

allOf:
  - $ref: touchscreen.yaml#

properties:
  compatible:
    const: samsung,fts5cu56a

  reg:
    maxItems: 1

  avdd-supply:
    description: Analog power supply

  vdd-supply:
    description: Digital power supply

  interrupts:
    maxItems: 1

required:
  - compatible
  - reg
  - avdd-supply
  - vdd-supply
  - interrupts

unevaluatedProperties: false

examples:
  - |
    #include <dt-bindings/interrupt-controller/irq.h>

    i2c {
        #address-cells = <1>;
        #size-cells = <0>;

        touchscreen@49 {
            compatible = "samsung,fts5cu56a";
            reg = <0x49>;
            interrupt-parent = <&gpio>;
            interrupts = <15 IRQ_TYPE_LEVEL_LOW>;
            avdd-supply = <&tsp_vdd>;
            vdd-supply = <&tsp_vdd>;
        };
    };
```
